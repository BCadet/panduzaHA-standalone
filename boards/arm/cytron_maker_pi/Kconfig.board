## boards/arm/cytron_maker_pi/Kconfig.board
```kconfig
# Copyright (c) 2021 Yonatan Schachter
# SPDX-License-Identifier: Apache-2.0

config BOARD_CYTRON_MAKER_PI
	bool "Cytron Raspberry Pi Pico Board"
	depends on SOC_RP2040
```

## dts/bindings/panduza/panduza,dios.yaml
```yaml
# Copyright (c) 2021 Nordic Semiconductor ASA
# SPDX-License-Identifier: Apache-2.0

description: |
  Panduza DIOs device tree node

  Example definition in devicetree:

    pza_dio {
        compatible = "panduza,dios";
        dios = <0 &gpioa 5 GPIO_ACTIVE_HIGH>,
               <1 &gpioc 13 GPIO_ACTIVE_LOW>;
    };

compatible: "panduza,dios"

include: [base.yaml]

properties:
  pza-gpios:
    type: phandle-array
    required: true
    description: array of DIOs to expose

  "#gpio-cells":
    type: int
    const: 2
```

## ppp-poc/build-f446/Kconfig/Kconfig.modules
```kconfig
menu "panduzaHA-ng (/home/bryan/pzaHa-workspace/panduzaHA-ng)"
osource "/home/bryan/pzaHa-workspace/panduzaHA-ng/Kconfig"
config ZEPHYR_PANDUZAHA_NG_MODULE
	bool
	default y
endmenu
menu "cmsis (/home/bryan/pzaHa-workspace/modules/hal/cmsis)"
osource "$(ZEPHYR_CMSIS_KCONFIG)"
config ZEPHYR_CMSIS_MODULE
	bool
	default y
endmenu
menu "hal_nordic (/home/bryan/pzaHa-workspace/modules/hal/nordic)"
osource "$(ZEPHYR_HAL_NORDIC_KCONFIG)"
config ZEPHYR_HAL_NORDIC_MODULE
	bool
	default y
endmenu
menu "hal_rpi_pico (/home/bryan/pzaHa-workspace/modules/hal/rpi_pico)"
osource "$(ZEPHYR_HAL_RPI_PICO_KCONFIG)"
config ZEPHYR_HAL_RPI_PICO_MODULE
	bool
	default y
endmenu
config ZEPHYR_STM32_MODULE
   bool
   default y
```

## ppp-poc/build-f446/Kconfig/Kconfig.shield
```kconfig
osource "/home/bryan/pzaHa-workspace/panduzaHA-ng/boards/shields/*/Kconfig.shield"
```

## ppp-poc/build-ppp/Kconfig/Kconfig.modules
```kconfig
menu "panduzaHA-ng (/home/cadet/pzaHA-workspace/panduzaHA-ng)"
osource "/home/cadet/pzaHA-workspace/panduzaHA-ng/Kconfig"
config ZEPHYR_PANDUZAHA_NG_MODULE
	bool
	default y
endmenu
menu "cmsis (/home/cadet/pzaHA-workspace/modules/hal/cmsis)"
osource "$(ZEPHYR_CMSIS_KCONFIG)"
config ZEPHYR_CMSIS_MODULE
	bool
	default y
endmenu
menu "hal_nordic (/home/cadet/pzaHA-workspace/modules/hal/nordic)"
osource "$(ZEPHYR_HAL_NORDIC_KCONFIG)"
config ZEPHYR_HAL_NORDIC_MODULE
	bool
	default y
endmenu
menu "hal_rpi_pico (/home/cadet/pzaHA-workspace/modules/hal/rpi_pico)"
osource "$(ZEPHYR_HAL_RPI_PICO_KCONFIG)"
config ZEPHYR_HAL_RPI_PICO_MODULE
	bool
	default y
endmenu
config ZEPHYR_STM32_MODULE
   bool
   default y
```

## ppp-poc/build-ppp/Kconfig/Kconfig.shield.defconfig
```kconfig
osource "/home/cadet/pzaHA-workspace/panduzaHA-ng/boards/shields/*/Kconfig.defconfig"
```

## ppp-poc/defconfig
```kconfig
CONFIG_UART_INTERRUPT_DRIVEN=y
# CONFIG_NET_IPV6 is not set
CONFIG_CLOCK_CONTROL=y
CONFIG_PINCTRL=y
CONFIG_GPIO=y
CONFIG_SERIAL=y
# CONFIG_NET_TCP_CHECKSUM is not set
CONFIG_NET_DRIVERS=y
CONFIG_SOC_SERIES_STM32F4X=y
CONFIG_SOC_STM32F410RX=y
CONFIG_ARM_MPU=y
CONFIG_HW_STACK_PROTECTION=y
CONFIG_CONSOLE=y
CONFIG_UART_CONSOLE=y
CONFIG_NET_PPP=y
CONFIG_PPP_CLIENT_CLIENTSERVER=y
CONFIG_MODEM_MODULES=y
CONFIG_MODEM_PPP=y
CONFIG_NETWORKING=y
CONFIG_NET_L2_PPP=y
CONFIG_NET_IPV4=y
CONFIG_NET_TCP=y
# CONFIG_NET_TCP_RANDOMIZED_RTO is not set
# CONFIG_NET_TCP_FAST_RETRANSMIT is not set
# CONFIG_NET_TCP_CONGESTION_AVOIDANCE is not set
# CONFIG_NET_TCP_ISN_RFC6528 is not set
# CONFIG_NET_TCP_REJECT_CONN_WITH_RST is not set
# CONFIG_NET_UDP is not set
CONFIG_NET_LOG=y
CONFIG_DNS_RESOLVER=y
CONFIG_MQTT_LIB=y
CONFIG_TEST_RANDOM_GENERATOR=y
```
